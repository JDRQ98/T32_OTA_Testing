; Simple CMM script for testing
PRINT "Hello from hello.cmm script!"
ENDDO 